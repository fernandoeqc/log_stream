## Kconfig.projbuild
```kconfig
menu "Server configuration"

    config USE_IPV4
        bool "USE_IPV4"
        default y

    config USE_IPV6
        bool "USE_IPV6"
        default n
        select CONNECT_IPV6

    config SERVER_PORT
        int "Server Port"
        range 0 65535
        default 3333
        help
            Local port the example server will listen on.

endmenu
```
